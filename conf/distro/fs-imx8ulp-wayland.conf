## conf/distro/fs-imx8ulp-wayland.conf
```bitbake
# i.MX DISTRO for Wayland without X11

include conf/distro/include/fsl-imx-base.inc
include conf/distro/include/fsl-imx-preferred-env.inc

DISTRO = "fs-imx8ulp-wayland"

PREFERRED_PROVIDER_virtual/bootloader:imx-nxp-bsp = "u-boot-fus"
PREFERRED_PROVIDER_virtual/kernel:imx-nxp-bsp = "linux-fus"

# Remove conflicting backends
DISTRO_FEATURES:remove = "directfb x11 "
DISTRO_FEATURES:append = " wayland pam systemd"
```

## conf/distro/fs-imx8ulp-xwayland.conf
```bitbake
# i.MX DISTRO for Wayland with X11

include conf/distro/include/fs-imx8ulp-base.inc
include conf/distro/include/fs-imx8ulp-preferred-env.inc

DISTRO = "fs-imx8ulp-xwayland"

# Remove conflicting backends
DISTRO_FEATURES:remove = "directfb "
DISTRO_FEATURES:append = " x11 wayland pam"
```

## conf/distro/fus-imx-xwayland.conf
```bitbake
# i.MX DISTRO for Wayland with X11

include conf/distro/include/fsl-imx-base.inc
include conf/distro/include/fsl-imx-preferred-env.inc

DISTRO = "fus-imx-xwayland"

PREFERRED_PROVIDER_virtual/bootloader:imx-nxp-bsp = "u-boot-fus"
PREFERRED_PROVIDER_virtual/kernel:imx-nxp-bsp = "linux-fus"

# Remove conflicting backends
DISTRO_FEATURES:remove = "directfb "
DISTRO_FEATURES:append = " x11 wayland pam"
```

## conf/layer.conf
```bitbake
# We have a conf and classes directory, add to BBPATH
BBPATH .= ":${LAYERDIR}"

# We have recipes-* directories, add to BBFILES
BBFILES += "${LAYERDIR}/recipes-*/*/*.bb \
            ${LAYERDIR}/recipes-*/*/*.bbappend"

BBFILE_COLLECTIONS += "meta-fus"
BBFILE_PATTERN_meta-fus = "^${LAYERDIR}/"
BBFILE_PRIORITY_meta-fus = "7"

LAYERDEPENDS_meta-fus = "core"
LAYERSERIES_COMPAT_meta-fus = "langdale mickledore"
```

## conf/machine/fsimx6ul.conf
```bitbake
#@TYPE: Machine
#@NAME: fsimx6ul
#@SOC: i.MX6UL/i.MX6ULL
#@DESCRIPTION: Machine configuration for F&S boards with i.MX6 UltraLite and i.MX6ULL
#@MAINTAINER: Hartmut Keller <keller@fs-net.de>

MACHINEOVERRIDES =. "mx6:mx6ul:mx6ull:fsimx6ul:"

UBOOT_SUFFIX ?= "nb0"

require conf/machine/include/imx-base.inc
require conf/machine/include/fus-base.inc
require conf/machine/include/arm/armv7a/tune-cortexa7.inc

#UBoot
UBOOT_MACHINE = "fsimx6ul_config"
UBOOT_SUFFIX:mx6ul-nxp-bsp = "nb0"
UBOOT_BINARY:mx6ul-nxp-bsp = "uboot.${UBOOT_SUFFIX}"

#Kernel
KERNEL_IMAGETYPE = "zImage"
KERNEL_DEVICETREE = "efusa7ul.dtb efusa7ull.dtb picocom1.2.dtb picocoremx6ul.dtb picocoremx6ul100.dtb picocoremx6ull.dtb picocoremx6ull100.dtb picocoma7.dtb picocoma7ull.dtb"

#RootFS
IMAGE_FSTYPES = "ubifs ext4 wic.gz"
WKS_FILE_DEPENDS:remove:mx6ul-nxp-bsp = "imx-boot"
SOC_DEFAULT_WKS_FILE:mx6ul-nxp-bsp= "fus-uboot-bootpart.wks.in"
UBOOT_WIC_BINARY:mx6ul-nxp-bsp = "uboot.nb0"
UBOOT_OFFSET = "2048"

# Sets the login console.
# Setting FUS_LOGIN_CONSOLE automatically opens a login at
# the tty defined in the uboot environment variable "login"
# You may also specify a login here with e.g
# SERIAL_CONSOLE = "115200 ttymxc1"
# but this will also always open a login at the linux debug console
# as it is systemd default.
SERIAL_CONSOLES = "FUS_LOGIN_CONSOLE"

# Add WIFI driver
#MACHINE_ESSENTIAL_EXTRA_RRECOMMENDS += "silex-wlanbt-fs-firmware"
#MACHINE_ESSENTIAL_EXTRA_RRECOMMENDS += "silex-wlanbt-fs"
```

## conf/machine/fsimx8ulp.conf
```bitbake
#@SOC: i.MX8ULP


require conf/machine/include/imx8ulp-evk.inc

UBOOT_CONFIG_BASENAME = "fsimx8ulp"

#OVERWRITE F+S devicetree folder
KERNEL_DEVICETREE_BASENAME = "soldercore8ulp-bbhd"
KERNEL_DEVICETREE = "F+S/${KERNEL_DEVICETREE_BASENAME}.dtb"

UPOWER_FIRMWARE_NAME = "upower_a1.bin"
SECO_FIRMWARE_NAME:mx8ulp-generic-bsp = "mx8ulpa1-ahab-container.img"
MACHINE_FEATURES:remove:fsimx8ulp = " soc-reva2"
MACHINE_FEATURES:append:fsimx8ulp = " soc-reva1"
IMX_SOC_REV:mx8ulp-generic-bsp = "A1"
IMXBOOT_TARGETS = "flash_singleboot_m33"
```

## conf/machine/rev0_fsimx8ulp.conf
```bitbake
#@TYPE: Machine
#@NAME: i.MX 8ULP EVK
#@SOC: i.MX8ULP
#@DESCRIPTION: Machine configuration for NXP i.MX 8ULP Evaluation Kit with LPDDR4
#@MAINTAINER: Jun Zhu <junzhu@nxp.com>

require conf/machine/include/imx8ulp-evk.inc

KERNEL_DEVICETREE_BASENAME = "soldercore8ulp-bbhd"


#OVERWRITE F+S devicetree folder
KERNEL_DEVICETREE = " \
    F+S/${KERNEL_DEVICETREE_BASENAME}.dtb \
"

KERNEL_DEVICETREE += " \
	F+S/soldercore8ulp-bbhd.dtb \
"

UBOOT_CONFIG_BASENAME = "fsimx8ulp"

#MACHINE_FEATURES += "soc-reva1"
MACHINE_FEATURES += "soc-reva0"
#UPOWER_FIRMWARE_NAME = "upower_a1.bin"
UPOWER_FIRMWARE_NAME = "upower_a0.bin"
#SECO_FIRMWARE_NAME = "mx8ulpa1-ahab-container.img"
SECO_FIRMWARE_NAME = "mx8ulpa0-ahab-container.img"


# Firmware Sentinel 0.9 has some issues with the reset command. Because of this, a downgrade is required.
# A recipe for the Sentinel 0.8 firmware has been created in meta-fus. 
PREFERRED_VERSION_firmware-sentinel = "0.8"
```

## meta-bsp/conf/machine/fsimx6.conf
```bitbake
#@TYPE: Machine
#@NAME: fsimx6
#@SOC: i.MX6
#@DESCRIPTION: Machine configuration for F&S boards with i.MX6 DualLite/Solo/Dual/Quad
#@MAINTAINER: Hartmut Keller <keller@fs-net.de>

MACHINEOVERRIDES =. "mx6:mx6dl:mx6q:"

require conf/machine/include/imx-base.inc
require conf/machine/include/fus-base.inc
require conf/machine/include/arm/armv7a/tune-cortexa9.inc

#UBoot
UBOOT_MACHINE = "fsimx6_config"
UBOOT_SUFFIX:mx6-nxp-bsp = "nb0"
UBOOT_BINARY:mx6-nxp-bsp = "uboot.${UBOOT_SUFFIX}"
UBOOT_WIC_BINARY:mx6-nxp-bsp = "uboot.${UBOOT_SUFFIX}"

#Kernel
KERNEL_IMAGETYPE = "zImage"
KERNEL_DEVICETREE = "armstonea9dl.dtb armstonea9q.dtb armstonea9r2dl.dtb armstonea9r2q.dtb armstonea9r3dl.dtb armstonea9r3q.dtb efusa9dl.dtb efusa9q.dtb efusa9r2dl.dtb efusa9r2q.dtb picomoda9dl.dtb picomoda9q.dtb netdcua9dl.dtb netdcua9q.dtb \
qblissa9dl.dtb qblissa9q.dtb qblissa9r2dl.dtb qblissa9r2q.dtb "

#RootFS
IMAGE_BOOT_FILES:mx6-nxp-bsp = " \
    ${KERNEL_IMAGETYPE} \
    ${KERNEL_DEVICETREE} \
"

IMAGE_FSTYPES = "ubifs ext4 wic.gz"
SOC_DEFAULT_WKS_FILE:mx6-nxp-bsp = "fus-uboot-bootpart.wks.in"

# i.MX6 UBoot starts for eMMC user partition at 0x0020_0000
UBOOT_OFFSET = "2048"

# Sets the login console.
# Setting FUS_LOGIN_CONSOLE automatically opens a login at
# the tty defined in the uboot environment variable "login"
# You may also specify a login here with e.g
# SERIAL_CONSOLE = "115200 ttymxc1"
# but this will also always open a login at the linux debug console
# as it is systemd default.
SERIAL_CONSOLES = "FUS_LOGIN_CONSOLE"
```

## meta-bsp/conf/machine/fsimx6ul.conf
```bitbake
#@TYPE: Machine
#@NAME: fsimx6ul
#@SOC: i.MX6UL/i.MX6ULL
#@DESCRIPTION: Machine configuration for F&S boards with i.MX6 UltraLite and i.MX6ULL
#@MAINTAINER: Hartmut Keller <keller@fs-net.de>

MACHINEOVERRIDES =. "mx6:mx6ul:mx6ull:"

UBOOT_SUFFIX ?= "nb0"

require conf/machine/include/imx-base.inc
require conf/machine/include/fus-base.inc
require conf/machine/include/arm/armv7a/tune-cortexa7.inc

#UBoot
UBOOT_MACHINE = "fsimx6ul_config"
UBOOT_SUFFIX:mx6ul-nxp-bsp = "nb0"
UBOOT_BINARY:mx6ul-nxp-bsp = "uboot.${UBOOT_SUFFIX}"

#Kernel
KERNEL_IMAGETYPE = "zImage"
KERNEL_DEVICETREE = "efusa7ul.dtb efusa7ull.dtb picocom1.2.dtb gar1.dtb gar2.dtb gar3.dtb picocoremx6ull.dtb"

#RootFS
#SDCARD_ROOTFS ?= "${DEPLOY_DIR_IMAGE}/${IMAGE_NAME}.rootfs.ext4"

# Sets the login console.
# Setting FUS_LOGIN_CONSOLE automatically opens a login at
# the tty defined in the uboot environment variable "login"
# You may also specify a login here with e.g
# SERIAL_CONSOLE = "115200 ttymxc1"
# but this will also always open a login at the linux debug console
# as it is systemd default.
SERIAL_CONSOLES = "FUS_LOGIN_CONSOLE"

# Add WIFI driver
MACHINE_ESSENTIAL_EXTRA_RRECOMMENDS += "silex-wlanbt-fs-firmware"
MACHINE_ESSENTIAL_EXTRA_RRECOMMENDS += "silex-wlanbt-fs"

# Mask imx-weston because it needs a GPU. The poky-weston version 2.0.0 is used instaed.
BBMASK += "/meta-fsl-bsp-release/imx/meta-bsp/recipes-graphics/wayland/weston_3.0.0.bb"
BBMASK += "/meta-fsl-bsp-release/imx/meta-bsp/recipes-graphics/wayland/weston_3.0.0.bbappend"
```

## meta-bsp/conf/machine/fsimx7ulp.conf
```bitbake
#@TYPE: Machine
#@NAME: fsimx7ulp
#@SOC: i.MX7ULP
#@DESCRIPTION: Machine configuration for F&S boards with i.MX7 Ultra Low Power
#@MAINTAINER: Hartmut Keller <keller@fs-net.de>

MACHINEOVERRIDES =. "mx7:mx7ulp:"
MACHINE_EXTRA_RRECOMMENDS:remove:mx7ulp-nxp-bsp = "imx-m4-demos"

require conf/machine/include/imx-base.inc
require conf/machine/include/fus-base.inc
require conf/machine/include/arm/armv7a/tune-cortexa7.inc


#UBoot
UBOOT_MACHINE = "fsimx7ulp_config"
UBOOT_SUFFIX:mx7ulp-nxp-bsp = "imx"
UBOOT_BINARY:mx7ulp-nxp-bsp = "u-boot-dtb.${UBOOT_SUFFIX}"


#Kernel
KERNEL_IMAGETYPE = "zImage"
KERNEL_DEVICETREE = "picocoremx7ulp.dtb"

#RootFS
IMAGE_BOOT_FILES_mx7ulp = " \
    ${KERNEL_IMAGETYPE} \
    ${KERNEL_DEVICETREE} \
"

IMAGE_FSTYPES = "ext4 wic.gz"
SOC_DEFAULT_WKS_FILE_mx7ulp = "fus-no-uboot-bootpart.wks.in"
WKS_FILE_DEPENDS:append:mx7ulp-nxp-bsp = " fsimx-m4-demos"
IMAGE_BOOT_FILES:append:mx7ulp-nxp-bsp = " power_mode_switch.img"

# Sets the login console.
# You may  specify a login here with e.g
# SERIAL_CONSOLE = "115200 ttyLP0"
# but this will also always open a login at the linux debug console
# as it is systemd default.
SERIAL_CONSOLES = "FUS_LOGIN_CONSOLE"
```

## meta-bsp/conf/machine/fsimx8x.conf
```bitbake
#@TYPE: Machine
#@NAME: fsimx8x
#@SOC: i.MX8X
#@DESCRIPTION: Machine configuration for F&S boards with i.MX8X
#@MAINTAINER: Kay Mueller <mueller@fs-net.de>

MACHINEOVERRIDES =. "mx8:mx8x:mx8qxp:mx8qxpc0:"

require conf/machine/include/imx-base.inc
require conf/machine/include/tune-cortexa35.inc

#UBoot
UBOOT_MACHINE="fsimx8x_defconfig"
UBOOT_SUFFIX_mx8x = "fs"
UBOOT_BINARY_mx8x = "uboot.${UBOOT_SUFFIX}"
UBOOT_WIC_BINARY = "u-boot-dtb.img"

#Kernel
KERNEL_IMAGETYPE = "Image"
KERNEL_DEVICETREE  = "F+S/efusmx8x.dtb"
KERNEL_DEVICETREE += "F+S/efusmx8x-lcdif-j070wvtc0211.dtb"
KERNEL_DEVICETREE += "F+S/efusmx8x-lcdif-rgt070qyh-13cp.dtb"

#RootFS
IMAGE_FSTYPES = "ubifs ext4 wic.gz"
WKS_FILE_DEPENDS_remove_mx8 = "imx-boot"
SOC_DEFAULT_WKS_FILE_mx8 = "fus-uboot-bootpart.wks.in"
# 8X UBoot starts for eMMC user partition at 0x0014_0000
UBOOT_OFFSET = "1280"

# Sets the login console.
# You may  specify a login here with e.g
# SERIAL_CONSOLE = "115200;ttymxc1"
# but this will also always open a login at the linux debug console
# as it is systemd default.
SERIAL_CONSOLES = "FUS_LOGIN_CONSOLE"
```

## meta-fus-bsp/conf/machine/fsimx93.conf
```bitbake
#@TYPE: Machine
#@NAME: fsimx93
#@SOC: i.MX93
#@DESCRIPTION: Machine configuration for F&S boards with i.MX93
#@MAINTAINER: Anatol Derksen <derksen@fs-net.de>

MACHINEOVERRIDES =. "mx93:"

require conf/machine/include/imx-base.inc
require conf/machine/include/fus-base.inc
require conf/machine/include/arm/armv8-2a/tune-cortexa55.inc

MACHINE_FEATURES += " pci wifi bluetooth optee"
MACHINE_FEATURES += " nxpiw612-sdio"

# Kernel
KERNEL_IMAGETYPE = "Image"
KERNEL_DEVICETREE  = "\
            F+S/picocoremx93.dtb \
            F+S/picocoremx93-BT070L1060CS0I1AD-A.dtb \
            F+S/picocoremx93-adp-mipi2mip1-ee0350et-2cp.dtb \
            F+S/picocoremx93-adp-lvds2lvds2-EE1010B1T-1CP.dtb \
            F+S/fs-osm-sf-mx93-adp-osm-bb.dtb \
            F+S/fs-osm-sf-mx93-adp-osm-bb_BT070L1060CS0I1AD-A.dtb \
            "

#UBoot
HOSTTOOLS:append = " crc32"
UBOOT_CONFIG_BASENAME = "fsimx93"
UBOOT_CONFIG ??= "fsimx93 fsimx93_secure_boot"
UBOOT_CONFIG[fsimx93] = "${UBOOT_CONFIG_BASENAME}_defconfig,sdcard"
UBOOT_CONFIG[fsimx93_secure_boot] = "${UBOOT_CONFIG_BASENAME}_secure_boot_defconfig,sdcard"
UBOOT_MAKE_TARGET = "uboot-info.fs"
UBOOT_SUFFIX = "bin"

# overwrite provider to build own bootloader (required)
PREFERRED_PROVIDER_u-boot:mx93-nxp-bsp = "u-boot-fus"
PREFERRED_PROVIDER_virtual/bootloader:mx93-nxp-bsp = "${PREFERRED_PROVIDER_u-boot}"

#NBoot
NBOOT_MAKE_TARGET = "nboot"

# Set ATF platform name
ATF_PLATFORM = "imx93"

DDR_FIRMWARE_NAME = " \
    lpddr4_dmem_1d_v202201.bin \
    lpddr4_dmem_2d_v202201.bin \
    lpddr4_imem_1d_v202201.bin \
    lpddr4_imem_2d_v202201.bin \
"

# We have to disable SERIAL_CONSOLE due to auto-serial-console
SERIAL_CONSOLES = "115200;ttyLP0"

#RootFS
IMAGE_FSTYPES = "ext4 wic.gz"
# set default wic file
WKS_FILE = "fus-no-uboot-bootpart.wks.in"
WKS_FILE_DEPENDS:remove = "imx-boot"
IMX_BOOT_SEEK = "32"

# Sets the login console.
# You may  specify a login here with e.g
# SERIAL_CONSOLE = "115200;ttymxc1"
# but this will also always open a login at the linux debug console
# as it is systemd default.
SERIAL_CONSOLES = "FUS_LOGIN_CONSOLE"

IMX_DEFAULT_BSP = "nxp"

# do not use ptest for qtbase and qtdeclarative.
# set to 0 in local.conf to use
DISABLE_PTEST:pn-qtbase ??= "1"
DISABLE_PTEST:pn-qtdeclarative ??= "1"
DISABLE_PTEST:pn-qtlanguageserver ??= "1"
DISABLE_PTEST:pn-qtwayland ??= "1"

DISTRO_FEATURES:remove:pn-qtbase = "${@bb.utils.contains('DISABLE_PTEST:pn-qtbase', '1', 'ptest', '', d)}"
DISTRO_FEATURES:remove:pn-qtdeclarative = "${@bb.utils.contains('DISABLE_PTEST:pn-qtdeclarative', '1', 'ptest', '', d)}"
DISTRO_FEATURES:remove:pn-qtlanguageserver = "${@bb.utils.contains('DISABLE_PTEST:pn-qtlanguageserver', '1', 'ptest', '', d)}"
DISTRO_FEATURES:remove:pn-qtwayland = "${@bb.utils.contains('DISABLE_PTEST:pn-qtwayland', '1', 'ptest', '', d)}"
```

## meta-fus-bsp/conf/machine/tbs2.conf
```bitbake
#@TYPE: Machine
#@NAME: tbs2
#@SOC: i.MX8MM
#@DESCRIPTION: Machine configuration for custom board tbs2
#@MAINTAINER: Patrick Jakob <jakob@fs-net.de>

MACHINEOVERRIDES =. "mx8:mx8m:mx8mm:"

require conf/machine/include/imx-base.inc
require conf/machine/include/tune-cortexa53.inc
#UBoot
UBOOT_CONFIG ??= "emmc"
UBOOT_CONFIG[sd] = "tbs2_defconfig"
UBOOT_CONFIG[emmc] = "tbs2_defconfig"
SPL_BINARY = "spl/u-boot-spl.bin"

# Set DDR FIRMWARE
DDR_FIRMWARE_NAME = "ddr3_imem_1d.bin ddr3_dmem_1d.bin"

# Set u-boot DTB
UBOOT_DTB_NAME = "tbs2.dtb"

# Set imx-mkimage boot target
IMXBOOT_TARGETS = "flash_ddr3l_val"

IMAGE_BOOTLOADER = "imx-boot"

BOOT_SPACE = "65536"

LOADADDR = ""
UBOOT_SUFFIX = "bin"
UBOOT_MAKE_TARGET = ""
IMX_BOOT_SEEK = "33"

#Kernel
KERNEL_IMAGETYPE = "Image"
KERNEL_DEVICETREE = "F+S/tbs2.dtb"
KERNEL_DEVICETREE += "F+S/tbs2-lcdif-adp-mipi2rgb-etm0350.dtb"

#RootFS
SDCARD_ROOTFS = "${DEPLOY_DIR_IMAGE}/${IMAGE_NAME}.rootfs.ext4"
IMAGE_FSTYPES = "ext4 wic.bmap wic.gz"

# Sets the login console.
# You may  specify a login here with e.g
# SERIAL_CONSOLE = "115200;ttymxc1"
# but this will also always open a login at the linux debug console
# as it is systemd default.
SERIAL_CONSOLES = "FUS_LOGIN_CONSOLE"

# add marvel wlan driver and firmware
MACHINE_FEATURES += "murata-1mw"
```
