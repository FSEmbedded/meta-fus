## meta-fus-sdk/conf/layer.conf
```bitbake
# We have a conf and classes directory, add to BBPATH
BBPATH .= ":${LAYERDIR}"

# We have recipes-* directories, add to BBFILES
BBFILES += "${LAYERDIR}/recipes-*/*/*.bb \
            ${LAYERDIR}/recipes-*/*/*.bbappend"

BBFILE_COLLECTIONS += "fus-sdk-release"
BBFILE_PATTERN_fus-sdk-release  = "^${LAYERDIR}/"
BBFILE_PRIORITY_fus-sdk-release  = "9"
LAYERVERSION_fus-sdk-release  = "1"
LAYERSERIES_COMPAT_fus-sdk-release = "mickledore scarthgap"

BBFILE_PATTERN_fsvybrid = "^${LAYERDIR}/"
BBFILE_PRIORITY_fsvybrid = "5"
LAYERVERSION_fsvybrid = "1"
LAYERSERIES_COMPAT_fsvybrid = "mickledore"

# We have our own implementeation of psplash
BBMASK += "/meta-imx/meta-bsp/recipes-core/psplash/psplash_git.bbappend"

BBFILES_DYNAMIC += " \
    chromium-browser-layer:${LAYERDIR}/dynamic-layers/chromium-browser-layer/*/*/*.bb \
    chromium-browser-layer:${LAYERDIR}/dynamic-layers/chromium-browser-layer/*/*/*.bbappend \
    \
    openembedded-layer:${LAYERDIR}/dynamic-layers/openembedded-layer/*/*/*.bb \
    openembedded-layer:${LAYERDIR}/dynamic-layers/openembedded-layer/*/*/*.bbappend \
    \
    multimedia-layer:${LAYERDIR}/dynamic-layers/multimedia-layer/*/*/*.bb \
    multimedia-layer:${LAYERDIR}/dynamic-layers/multimedia-layer/*/*/*.bbappend \
    \
    qt6-layer:${LAYERDIR}/dynamic-layers/qt6-layer/*/*/*.bb \
    qt6-layer:${LAYERDIR}/dynamic-layers/qt6-layer/*/*/*.bbappend \
"
```

## sources/meta-fus/conf/distro/include/fus-common.inc
```bitbake
# Common settings for all F&S boards

UBOOT_ENTRYPOINT = "0x80800000"
UBOOT_ENTRYPOINT_mx6 = "0x10800000"
UBOOT_ENTRYPOINT_mx6sx = "0x80800000"
UBOOT_ENTRYPOINT_mx6ul = "0x80800000"
UBOOT_ENTRYPOINT_mx7ulp = "0x60800000"

PREFERRED_PROVIDER_u-boot_mx6 = "u-boot-fus"
PREFERRED_PROVIDER_u-boot_mx6ul = "u-boot-fus"
PREFERRED_PROVIDER_u-boot_mx6sx = "u-boot-fus"
PREFERRED_PROVIDER_u-boot_mx7ulp = "u-boot-fsimx7ulp"

PREFERRED_PROVIDER_virtual/bootloader_mx6 = "u-boot-fus"
PREFERRED_PROVIDER_virtual/bootloader_mx6ul = "u-boot-fus"
PREFERRED_PROVIDER_virtual/bootloader_mx6sx = "u-boot-fus"
PREFERRED_PROVIDER_virtual/bootloader_mx7ulp = "u-boot-fsimx7ulp"

PREFERRED_PROVIDER_virtual/kernel_mx6 = "linux-fus"
PREFERRED_PROVIDER_virtual/kernel_mx6ul = "linux-fus"
PREFERRED_PROVIDER_virtual/kernel_mx6sx = "linux-fus"
PREFERRED_PROVIDER_virtual/kernel_mx7ulp = "linux-fus"

# The FSTYPES need to be set here with "=" instead of "?=",  otherwise they will get
# overwritten in meta-fsl-bsp-release/imx/meta-sdk/conf/distro/include/fsl-imx-base.inc
# Priorities should be like this:
# 1. IMAGE_FSTYPES_mx6ul  = "sdcard" (overwrites 2,3 and 4)
# 2. IMAGE_FSTYPES_mx6ul ?= "sdcard" (overwrites 3 and 4)
# 3. IMAGE_FSTYPES        = "sdcard" (overwrites 4) <-- fsl-imx-base.inc
# 4. IMAGE_FSTYPES       ?= "sdcard"
IMAGE_FSTYPES = "ubifs sdcard"

MKUBIFS_ARGS = "-m 2048 -e 126976 -c 2048"

# Remove image_types_fsl because there is a awk command which search after a
# point(.) in the devicetrees. But we have 2 points in the devicetree 
# picocom1.2.dtb so the awk command find the first point, so the new name is
# picocom1 instead of picocom1.2. And thats why you get an error at compile 
# time. Thats why we copy the image_types_fsl and rename it as image_types_fus
# and changed the line in the original file from
# "DTS_BASE_NAME=`basename ${DTS_FILE} | awk -F "." '{print $1}'`" to
# "DTS_BASE_NAME=`basename ${DTS_FILE} | awk -F ".dtb" '{print $1}'`"
# The Original file will be find in sources/meta-fsl-arm/classes/
# image_types_fsl.bbclass
IMAGE_CLASSES_remove = "image_types_fsl"
IMAGE_CLASSES += "image_types_fus"

# necessary, will be set in fsl-imx-preferred-env.inc
UBOOT_SUFFIX_mx6ul = "nb0"
UBOOT_MAKE_TARGET_mx6ul = ""

DISTRO_NAME = "F&S i.MX Release Distro"
SANITY_TESTED_DISTROS += "fedora-27"
```

## sources/meta-fus/conf/machine/fsimx6ul.conf
```bitbake
#@TYPE: Machine
#@NAME: fsimx6ul
#@SOC: i.MX6UL/i.MX6ULL
#@DESCRIPTION: Machine configuration for F&S boards with i.MX6 UltraLite and i.MX6ULL
#@MAINTAINER: Hartmut Keller <keller@fs-net.de>

MACHINEOVERRIDES =. "mx6:mx6ul:mx6ull:"

UBOOT_SUFFIX ?= "nb0"

include conf/machine/include/imx-base.inc
include conf/machine/include/tune-cortexa7.inc

#UBoot
UBOOT_MACHINE = "fsimx6ul_config"

#Kernel
KERNEL_IMAGETYPE = "zImage"
KERNEL_DEVICETREE = "efusa7ul.dtb efusa7ull.dtb picocom1.2.dtb gar1.dtb gar2.dtb picocoremx6ul.dtb picocoremx6ull.dtb picocoma7.dtb picocoma7ull.dtb picocoremx6ul100.dtb picocoremx6ull100.dtb"

#RootFS
IMAGE_FSTYPES_mx6ul = "ubifs ext4 sdcard"

#SDcard
# UBoot Offset
UBOOT_SEEK_mx6ul ?= "2048"
# Bootpartition
# Offset
IMAGE_ROOTFS_ALIGNMENT_mx6ul ?= "8192"
# Size
BOOT_SPACE_mx6ul ?= "90112"

# Sets the login console.
# Setting FUS_LOGIN_CONSOLE automatically opens a login at
# the tty defined in the uboot environment variable "login"
# You may also specify a login here with e.g
# SERIAL_CONSOLE = "115200 ttymxc1"
# but this will also always open a login at the linux debug console
# as it is systemd default.
SERIAL_CONSOLE = "FUS_LOGIN_CONSOLE"

# Add WIFI driver
MACHINE_ESSENTIAL_EXTRA_RRECOMMENDS += "silex-wlanbt-fs-firmware"
MACHINE_ESSENTIAL_EXTRA_RRECOMMENDS += "silex-wlanbt-fs"

# Mask imx-weston because it needs a GPU. The poky-weston version 2.0.0 is used instaed.
BBMASK += "/meta-fsl-bsp-release/imx/meta-bsp/recipes-graphics/wayland/weston_3.0.0.bb"
BBMASK += "/meta-fsl-bsp-release/imx/meta-bsp/recipes-graphics/wayland/weston_3.0.0.bbappend"

# end of imx6ul-common.inc
```
