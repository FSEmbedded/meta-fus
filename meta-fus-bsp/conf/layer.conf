## meta-fus-bsp/conf/machine/fsimx8mm.conf
```bitbake
#@TYPE: Machine
#@NAME: fsimx8mm
#@SOC: i.MX8MM
#@DESCRIPTION: Machine configuration for F&S boards with i.MX8M Mini
#@MAINTAINER: Anatol Derksen <derksen@fs-net.de>

MACHINEOVERRIDES =. "mx8:mx8m:mx8mm:fsimx8mm:"

require conf/machine/include/imx-base.inc
require conf/machine/include/fus-base.inc
require conf/machine/include/arm/armv8a/tune-cortexa53.inc

# Mainline BSP defaults to "generic" cortexa53 configuration,
# adjust it here to include crypto extension which enables
# inline NEON and FPU code generation
DEFAULTTUNE:use-mainline-bsp = "cortexa53-crypto"

MACHINE_FEATURES:append = " pci wifi bluetooth"
MACHINE_FEATURES:append:imx-nxp-bsp = " optee "
MACHINE_FEATURES:append:imx-nxp-bsp  = " nxp8997-sdio"

#Kernel
KERNEL_IMAGETYPE = "Image"
KERNEL_DEVICETREE:mx8mm-generic-bsp = "F+S/picocoremx8mm-lpddr4.dtb"
KERNEL_DEVICETREE:mx8mm-generic-bsp += "F+S/picocoremx8mm-lpddr4-lcdif-tc358775-j070wvtc0211.dtb"
KERNEL_DEVICETREE:mx8mm-generic-bsp += "F+S/picocoremx8mm-lpddr4-lcdif-adp-mipi2mipi1-ee0350et-2cp.dtb"
KERNEL_DEVICETREE:mx8mm-generic-bsp += "F+S/picocoremx8mm-lpddr4-lcdif-adp-mipi2rgb.dtb"
KERNEL_DEVICETREE:mx8mm-generic-bsp += "F+S/picocoremx8mm-lpddr4-tc358775-BT070L1060CS0I1AD-A.dtb"
KERNEL_DEVICETREE:mx8mm-generic-bsp += "F+S/picocoremx8mmr2-lpddr4.dtb"
KERNEL_DEVICETREE:mx8mm-generic-bsp += "F+S/picocoremx8mmr2-lpddr4-lcdif-tc358775-j070wvtc0211.dtb"
KERNEL_DEVICETREE:mx8mm-generic-bsp += "F+S/picocoremx8mmr2-lpddr4-lcdif-adp-mipi2mipi1-ee0350et-2cp.dtb"
KERNEL_DEVICETREE:mx8mm-generic-bsp += "F+S/picocoremx8mmr2-lpddr4-lcdif-adp-mipi2rgb.dtb"
KERNEL_DEVICETREE:mx8mm-generic-bsp += "F+S/picocoremx8mmr2-lpddr4-tc358775-BT070L1060CS0I1AD-A.dtb"
KERNEL_DEVICETREE:mx8mm-generic-bsp += "F+S/picocoremx8mm-ddr3l.dtb"
KERNEL_DEVICETREE:mx8mm-generic-bsp += "F+S/picocoremx8mm-ddr3l-lcdif-tc358775-j070wvtc0211.dtb"
KERNEL_DEVICETREE:mx8mm-generic-bsp += "F+S/picocoremx8mm-ddr3l-lcdif-adp-mipi2mipi1-ee0350et-2cp.dtb"
KERNEL_DEVICETREE:mx8mm-generic-bsp += "F+S/picocoremx8mm-ddr3l-lcdif-adp-mipi2rgb.dtb"
KERNEL_DEVICETREE:mx8mm-generic-bsp += "F+S/picocoremx8mm-ddr3l-tc358775-BT070L1060CS0I1AD-A.dtb"
KERNEL_DEVICETREE:mx8mm-generic-bsp += "F+S/osm8mm.dtb"
KERNEL_DEVICETREE:mx8mm-generic-bsp += "F+S/osm8mm-lcdif-adp-mipi2mipi1-ee0350et-2cp.dtb"
KERNEL_DEVICETREE:mx8mm-generic-bsp += "F+S/osm8mm-lcdif-adp-mipi2lvds1-BT070L1060CS0I1AD-A.dtb"

#UBoot
HOSTTOOLS:append = " crc32"
UBOOT_CONFIG_BASENAME = "fsimx8mm"
UBOOT_CONFIG = "fsimx8mm"
#UBOOT_CONFIG = "fsimx8mm fsimx8mm_secure_boot"
UBOOT_CONFIG[fsimx8mm] = "${UBOOT_CONFIG_BASENAME}_defconfig,sdcard"
#UBOOT_CONFIG[fsimx8mm_secure_boot] = "${UBOOT_CONFIG_BASENAME}_secure_boot_defconfig,sdcard"
UBOOT_MAKE_TARGET = "uboot.fs"
UBOOT_SUFFIX:mx8mm-generic-bsp = "fs"
UBOOT_BINARY:mx8mm-generic-bsp = "uboot.${UBOOT_SUFFIX}"

# overwrite provider to build own bootloader (required)
PREFERRED_PROVIDER_u-boot:mx8mm-generic-bsp = "u-boot-fus"
PREFERRED_PROVIDER_virtual/bootloader:mx8mm-generic-bsp = "${PREFERRED_PROVIDER_u-boot}"

# Set ATF platform name
ATF_PLATFORM = "imx8mm"

#RootFS
IMAGE_FSTYPES = "ubifs ext4 wic.gz"
WKS_FILE_DEPENDS:remove:mx8mm-generic-bsp = "imx-boot"
SOC_DEFAULT_WKS_FILE:mx8mm-generic-bsp= "fus-no-uboot-bootpart.wks.in"

# Sets the login console.
# You may  specify a login here with e.g
# SERIAL_CONSOLE = "115200;ttymxc1"
# but this will also always open a login at the linux debug console
# as it is systemd default.
SERIAL_CONSOLES = "FUS_LOGIN_CONSOLE"
IMX_DEFAULT_BSP = "nxp"
```

## meta-fus-bsp/conf/machine/fsimx8mn.conf
```bitbake
#@TYPE: Machine
#@NAME: fsimx8mn
#@SOC: i.MX8MN
#@DESCRIPTION: Machine configuration for F&S boards with i.MX8M Mini
#@MAINTAINER: Anatol Derksen <derksen@fs-net.de>

MACHINEOVERRIDES =. "mx8:mx8m:mx8mn:fsimx8mn:"

require conf/machine/include/imx-base.inc
require conf/machine/include/fus-base.inc
require conf/machine/include/arm/armv8a/tune-cortexa53.inc

MACHINE_FEATURES:append: = "wifi bluetooth optee"
MACHINE_FEATURES:append:imx-nxp-bsp = " nxp8997-sdio"

#Kernel
KERNEL_IMAGETYPE = "Image"
KERNEL_DEVICETREE  = "F+S/picocoremx8mn-lpddr4.dtb"
KERNEL_DEVICETREE += "F+S/picocoremx8mn-lpddr4-lcdif-tc358775-j070wvtc0211.dtb"
KERNEL_DEVICETREE += "F+S/picocoremx8mn-lpddr4-lcdif-adp-mipi2mipi1-ee0350et-2cp.dtb"
KERNEL_DEVICETREE += "F+S/picocoremx8mn-lpddr4-tc358775-BT070L1060CS0I1AD-A.dtb"
KERNEL_DEVICETREE += "F+S/picocoremx8mn-ddr3l.dtb"
KERNEL_DEVICETREE += "F+S/picocoremx8mn-ddr3l-lcdif-tc358775-j070wvtc0211.dtb"
KERNEL_DEVICETREE += "F+S/picocoremx8mn-ddr3l-lcdif-adp-mipi2mipi1-ee0350et-2cp.dtb"
KERNEL_DEVICETREE += "F+S/picocoremx8mn-ddr3l-lcdif-adp-mipi2rgb.dtb"
KERNEL_DEVICETREE += "F+S/picocoremx8mn-ddr3l-tc358775-BT070L1060CS0I1AD-A.dtb"

#UBoot
HOSTTOOLS:append = " crc32"
UBOOT_CONFIG_BASENAME = "fsimx8mn"
UBOOT_CONFIG ??= "fsimx8mn fsimx8mn_secure_boot"
UBOOT_CONFIG[fsimx8mn] = "${UBOOT_CONFIG_BASENAME}_defconfig,sdcard"
UBOOT_CONFIG[fsimx8mn_secure_boot] = "${UBOOT_CONFIG_BASENAME}_secure_boot_defconfig,sdcard"
UBOOT_MAKE_TARGET = "uboot.fs"
UBOOT_SUFFIX:mx8mn-generic-bsp = "fs"
UBOOT_BINARY:mx8mn-generic-bsp = "uboot.${UBOOT_SUFFIX}"

# overwrite provider to build own bootloader (required)
PREFERRED_PROVIDER_u-boot:mx8mn-generic-bsp = "u-boot-fus"
PREFERRED_PROVIDER_virtual/bootloader:mx8mn-generic-bsp = "${PREFERRED_PROVIDER_u-boot}"
PREFERRED_VERSION_u-boot-fus:mx8mn-generic-bsp ??= "2021.04"

# Set ATF platform name
ATF_PLATFORM = "imx8mn"

#RootFS
IMAGE_FSTYPES = "ubifs ext4 wic.gz"
WKS_FILE_DEPENDS:remove:mx8mn-generic-bsp = "imx-boot"
SOC_DEFAULT_WKS_FILE:mx8mn-generic-bsp= "fus-no-uboot-bootpart.wks.in"

# Sets the login console.
# You may  specify a login here with e.g
# SERIAL_CONSOLE = "115200;ttymxc1"
# but this will also always open a login at the linux debug console
# as it is systemd default.
SERIAL_CONSOLES = "FUS_LOGIN_CONSOLE"
IMX_DEFAULT_BSP = "nxp"
```

## meta-fus-bsp/conf/machine/fsimx8ulp.conf
```bitbake
#@TYPE: Machine
#@NAME: fsimx8ulp
#@SOC: i.MX8ULP
#@DESCRIPTION: Machine configuration for F&S boards with i.MX8ULP
#@MAINTAINER: Claudio Senatore <senatore@fs-net.de>

MACHINEOVERRIDES =. "mx8ulp:"

require conf/machine/include/imx-base.inc
require conf/machine/include/fus-base.inc
require conf/machine/include/arm/armv8a/tune-cortexa35.inc

MACHINE_FEATURES:append = " pci wifi bluetooth optee"
MACHINE_FEATURES:append = " nxpiw612-sdio nxp8997-sdio"

MACHINE_EXTRA_RRECOMMENDS:append = " clksrc-tpm"

# Kernel
KERNEL_IMAGETYPE = "Image"
KERNEL_DEVICETREE = "\
        F+S/picocoremx8ulp.dtb \
        F+S/picocoremx8ulp-adp-mipi2mipi1-ee0350et-2cp.dtb \
        F+S/picocoremx8ulp-adp-mipi2lvds1-BT070L1060CS0I1AD-A.dtb \
		F+S/fs-osm-sf-mx8ulp-adp-osm-bb.dtb \
        F+S/fs-osm-sf-mx8ulp-adp-osm-bb-ee0350et-2cp.dtb \
        F+S/fs-osm-sf-mx8ulp-adp-osm-bb-BT070L1060CS0I1AD-A.dtb \
"

KERNEL_CLASSES += "kernel-fitimage"
KERNEL_IMAGETYPES += " fitImage "
UBOOT_LOADADDRESS = "0x80400000"
UBOOT_ENTRYPOINT = "0x80400000"
UBOOT_DTB_LOADADDRESS = "0x83000000"

#UBoot
HOSTTOOLS:append = " crc32"
UBOOT_CONFIG_BASENAME = "fsimx8ulp"
UBOOT_CONFIG ??= "fsimx8ulp"
UBOOT_CONFIG[fsimx8ulp] = "${UBOOT_CONFIG_BASENAME}_defconfig,sdcard"
UBOOT_MAKE_TARGET = "uboot.fs"
UBOOT_SUFFIX = "fs"
UBOOT_BINARY = "uboot.${UBOOT_SUFFIX}"

# overwrite provider to build own bootloader (required)
PREFERRED_PROVIDER_u-boot:mx8ulp-nxp-bsp = "u-boot-fus"
PREFERRED_PROVIDER_virtual/bootloader:mx8ulp-nxp-bsp = "${PREFERRED_PROVIDER_u-boot}"

# Set ATF platform name
ATF_PLATFORM = "imx8ulp"

UPOWER_FIRMWARE_NAME = "upower_a1.bin"
SECO_FIRMWARE_NAME:mx8ulp-generic-bsp = "mx8ulpa2-ahab-container.img"
MACHINE_FEATURES:remove:fsimx8ulp = " soc-reva1"
MACHINE_FEATURES:append:fsimx8ulp = " soc-reva2"
IMX_SOC_REV:mx8ulp-generic-bsp = "A2"

# We have to disable SERIAL_CONSOLE due to auto-serial-console
SERIAL_CONSOLES = "115200;ttyLP0"

#RootFS
IMAGE_FSTYPES = "ext4 wic.gz"
# set default wic file
WKS_FILE = "fus-no-uboot-bootpart.wks.in"
WKS_FILE_DEPENDS:remove = "imx-boot"
IMX_BOOT_SEEK = "32"

# Sets the login console.
# You may  specify a login here with e.g
# SERIAL_CONSOLE = "115200;ttymxc1"
# but this will also always open a login at the linux debug console
# as it is systemd default.
SERIAL_CONSOLES = "FUS_LOGIN_CONSOLE"

IMX_DEFAULT_BSP = "nxp"

# do not use ptest for qtbase and qtdeclarative.
# set to 0 in local.conf to use
DISABLE_PTEST:pn-qtbase ??= "1"
DISABLE_PTEST:pn-qtdeclarative ??= "1"
DISABLE_PTEST:pn-qtlanguageserver ??= "1"
DISABLE_PTEST:pn-qtwayland ??= "1"

DISTRO_FEATURES:remove:pn-qtbase = "${@bb.utils.contains('DISABLE_PTEST:pn-qtbase', '1', 'ptest', '', d)}"
DISTRO_FEATURES:remove:pn-qtdeclarative = "${@bb.utils.contains('DISABLE_PTEST:pn-qtdeclarative', '1', 'ptest', '', d)}"
DISTRO_FEATURES:remove:pn-qtlanguageserver = "${@bb.utils.contains('DISABLE_PTEST:pn-qtlanguageserver', '1', 'ptest', '', d)}"
DISTRO_FEATURES:remove:pn-qtwayland = "${@bb.utils.contains('DISABLE_PTEST:pn-qtwayland', '1', 'ptest', '', d)}"
```

## meta-fus-bsp/conf/machine/fsimx91.conf
```bitbake
#@TYPE: Machine
#@NAME: fsimx91
#@SOC: i.MX91
#@DESCRIPTION: Machine configuration for F&S boards with i.MX91
#@MAINTAINER: Claudio Senatore <senatore@fs-net.de>

MACHINEOVERRIDES =. "mx91:"

require conf/machine/include/imx-base.inc
require conf/machine/include/fus-base.inc
require conf/machine/include/arm/armv8-2a/tune-cortexa55.inc

MACHINE_FEATURES += " pci wifi bluetooth optee"
MACHINE_FEATURES += " nxpiw612-sdio nxp8997-sdio"

# Kernel
KERNEL_IMAGETYPE = "Image"
KERNEL_DEVICETREE  = "\
            F+S/picocoremx91.dtb \
            F+S/fs-osm-sf-mx91-adp-osm-bb.dtb \
"
KERNEL_CLASSES += "kernel-fitimage"
KERNEL_IMAGETYPES += " fitImage "
UBOOT_LOADADDRESS = "0x80400000"
UBOOT_ENTRYPOINT = "0x80400000"
UBOOT_DTB_LOADADDRESS = "0x83000000"

#UBoot
HOSTTOOLS:append = " crc32"
UBOOT_CONFIG_BASENAME = "fsimx91"
UBOOT_CONFIG ??= "fsimx91"
UBOOT_CONFIG[fsimx91] = "${UBOOT_CONFIG_BASENAME}_defconfig,sdcard"
UBOOT_MAKE_TARGET = "uboot.fs"
UBOOT_SUFFIX = "fs"
UBOOT_BINARY = "uboot.${UBOOT_SUFFIX}"

# overwrite provider to build own bootloader (required)
PREFERRED_PROVIDER_u-boot:mx91-generic-bsp = "u-boot-fus"
PREFERRED_PROVIDER_virtual/bootloader:mx91-generic-bsp = "${PREFERRED_PROVIDER_u-boot}"

# Set ATF platform name
ATF_PLATFORM = "imx91"

DDR_FIRMWARE_NAME = " \
    lpddr4_dmem_1d_v202201.bin \
    lpddr4_dmem_2d_v202201.bin \
    lpddr4_imem_1d_v202201.bin \
    lpddr4_imem_2d_v202201.bin \
"

# We have to disable SERIAL_CONSOLE due to auto-serial-console
SERIAL_CONSOLES = "115200;ttyLP0"

#RootFS
IMAGE_FSTYPES = "ext4 wic.gz"
# set default wic file
WKS_FILE = "fus-no-uboot-bootpart.wks.in"
WKS_FILE_DEPENDS:remove = "imx-boot"
IMX_BOOT_SEEK = "32"

# Sets the login console.
# You may  specify a login here with e.g
# SERIAL_CONSOLE = "115200;ttymxc1"
# but this will also always open a login at the linux debug console
# as it is systemd default.
SERIAL_CONSOLES = "FUS_LOGIN_CONSOLE"

IMX_DEFAULT_BSP = "nxp"
```

## meta-fus-bsp/conf/machine/fsimx95.conf
```bitbake
#@TYPE: Machine
#@NAME: fsimx95
#@SOC: i.MX95
#@DESCRIPTION: Machine configuration for F&S boards with i.MX95
#@MAINTAINER: Kay Müller <mueller@fs-net.de>

MACHINEOVERRIDES =. "mx95:"

require conf/machine/include/imx-base.inc
require conf/machine/include/fus-base.inc
require conf/machine/include/arm/armv8-2a/tune-cortexa55.inc

MACHINE_FEATURES += " pci wifi bluetooth optee"
MACHINE_FEATURES += " nxpiw612-sdio nxp8997-sdio"

# Kernel
KERNEL_IMAGETYPE = "Image"
KERNEL_DEVICETREE  = "\
            F+S/fssm95s.dtb \
            F+S/fssm95s-BT070L1060CS0I1AD-A.dtb \
            F+S/picocoremx95.dtb \
            "
#KERNEL_CLASSES += "kernel-fitimage"
#KERNEL_IMAGETYPES += " fitImage "
UBOOT_LOADADDRESS = "0x90400000"
UBOOT_ENTRYPOINT = "0x90200000"
UBOOT_DTB_LOADADDRESS = "0x93000000"

#UBoot
HOSTTOOLS:append = " crc32"
UBOOT_CONFIG_BASENAME = "fsimx95"
UBOOT_CONFIG ??= "fsimx95"
UBOOT_CONFIG[fsimx95] = "${UBOOT_CONFIG_BASENAME}_defconfig"
UBOOT_MAKE_TARGET = "uboot.fs"
UBOOT_SUFFIX = "fs"
UBOOT_BINARY = "uboot.${UBOOT_SUFFIX}"

# overwrite provider to build own bootloader (required)
PREFERRED_PROVIDER_u-boot:mx95-nxp-bsp = "u-boot-fus"
PREFERRED_PROVIDER_virtual/bootloader:mx95-nxp-bsp = "${PREFERRED_PROVIDER_u-boot}"

# Set ATF platform name
ATF_PLATFORM = "imx95"

DDR_FIRMWARE_NAME = " \
    lpddr4x_imem_v202409.bin \
    lpddr4x_dmem_v202409.bin \
    lpddr4x_imem_qb_v202409.bin \
    lpddr4x_dmem_qb_v202409.bin \
    lpddr5_imem_v202409.bin \
    lpddr5_dmem_v202409.bin \
    lpddr5_imem_qb_v202409.bin \
    lpddr5_dmem_qb_v202409.bin \
"

# We have to disable SERIAL_CONSOLE due to auto-serial-console
SERIAL_CONSOLES = "115200;ttyLP0"

#RootFS
IMAGE_FSTYPES = "ext4 wic"
# set default wic file
WKS_FILE = "fus-no-uboot-bootpart.wks.in"
WKS_FILE_DEPENDS:remove = "imx-boot"
IMX_BOOT_SEEK = "32"

# Sets the login console.
# You may  specify a login here with e.g
# SERIAL_CONSOLE = "115200;ttymxc1"
# but this will also always open a login at the linux debug console
# as it is systemd default.
SERIAL_CONSOLES = "FUS_LOGIN_CONSOLE"

IMX_DEFAULT_BSP = "nxp"
```

## meta-fus-bsp/conf/machine/include/fus-base.inc
```bitbake
# Common settings for all F&S boards

UBOOT_ENTRYPOINT:mx6-generic-bsp    = "0x10800000"
UBOOT_ENTRYPOINT:mx6sx-generic-bsp  = "0x80800000"
UBOOT_ENTRYPOINT:mx6ul-generic-bsp  = "0x80800000"
UBOOT_ENTRYPOINT:mx7ulp-generic-bsp = "0x60008000"

UBOOT_ENTRYPOINT:mx8mm-generic-bsp  = "0x40008000"
UBOOT_ENTRYPOINT:mx8mn-generic-bsp  = "0x40008000"
UBOOT_ENTRYPOINT:mx8mp-generic-bsp  = "0x40008000"

PREFERRED_PROVIDER_virtual/kernel:mx6-generic-bsp    ??= "linux-fus"
PREFERRED_PROVIDER_virtual/kernel:mx6sx-generic-bsp  ??= "linux-fus"
PREFERRED_PROVIDER_virtual/kernel:mx6ul-generic-bsp  ??= "linux-fus"
PREFERRED_PROVIDER_virtual/kernel:mx7ulp-generic-bsp ??= "linux-fus"

PREFERRED_PROVIDER_virtual/kernel:mx6-mainline-bsp ??= "linux-mainline-fus"

PREFERRED_PROVIDER_virtual/kernel:mx8mm-generic-bsp ??= "linux-fus"
PREFERRED_PROVIDER_virtual/kernel:mx8mn-generic-bsp ??= "linux-fus"
PREFERRED_PROVIDER_virtual/kernel:mx8mp-generic-bsp ??= "linux-fus"
PREFERRED_PROVIDER_virtual/kernel:mx8ulp-generic-bsp ??= "linux-fus"

PREFERRED_PROVIDER_virtual/kernel:mx8mp-mainline-bsp ??= "linux-mainline-fus"
PREFERRED_PROVIDER_virtual/kernel:mx8mm-mainline-bsp ??= "linux-mainline-fus"

PREFERRED_PROVIDER_virtual/kernel:mx93-generic-bsp ??= "linux-fus"
PREFERRED_PROVIDER_virtual/kernel:mx95-generic-bsp ??= "linux-fus"

PREFERRED_PROVIDER_virtual/bootloader:mx6-generic-bsp    ??= "u-boot-fus"
PREFERRED_PROVIDER_virtual/bootloader:mx6sx-generic-bsp  ??= "u-boot-fus"
PREFERRED_PROVIDER_virtual/bootloader:mx6ul-generic-bsp  ??= "u-boot-fus"
PREFERRED_PROVIDER_virtual/bootloader:mx7ulp-generic-bsp ??= "u-boot-fus"

PREFERRED_PROVIDER_virtual/bootloader:mx8mm-generic-bsp  ??= "u-boot-fus"
PREFERRED_PROVIDER_virtual/bootloader:mx8mn-generic-bsp  ??= "u-boot-fus"
PREFERRED_PROVIDER_virtual/bootloader:mx8mp-generic-bsp  ??= "u-boot-fus"
PREFERRED_PROVIDER_virtual/bootloader:mx8ulp-generic-bsp  ??= "u-boot-fus"

PREFERRED_PROVIDER_virtual/bootloader:imx93-generic-bsp  ??= "u-boot-fus"
PREFERRED_PROVIDER_virtual/bootloader:imx95-generic-bsp  ??= "u-boot-fus"
```
